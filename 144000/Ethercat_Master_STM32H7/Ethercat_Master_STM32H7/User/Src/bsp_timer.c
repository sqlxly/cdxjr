/*
*********************************************************************************************************
*
*	模块名称 : 定时器模块
*	文件名称 : bsp_timer.c
*	版    本 : V1.0
*	说    明 : 配置systick定时器作为系统滴答定时器。缺省定时周期为100us。
*
*
*
*********************************************************************************************************
*/

#include "bsp_timer.h"
#include "osal.h"
#include "tim.h"

extern TIM_HandleTypeDef htim2;

__IO uint32_t g_iRunTime = 0;

uint32_t bsp_GetTickCount(void)
{
	g_iRunTime=__HAL_TIM_GET_COUNTER(&htim2);
   return g_iRunTime;
}


/******************************************************************************
***************************************************************************************
** 函数名称: Delay_us 
** 功能描述: 主频在168MHz时的，粗略延时函数
** 参    数: 延时微秒
** 返 回 值: None       
****************************************************************************************/
void Delay_us(uint32_t time)
{    
   uint32_t i=0; 
   while(time--)
   {
      i=500;   
      while(i--);    
   }
}
 /***************************************************************************************
** 函数名称: Delay_ms
** 功能描述: 主频在168MHz时的，粗略延时函数，经示波器检测，相对较准确。
** 参    数: time
** 返 回 值: None       
****************************************************************************************/
void Delay_ms(uint32_t time)
{
   uint32_t i=0;
   HAL_Delay(time);
//   while(time--)
//   {
//      i=245059; 
//      while(i--);    
//   }
}
void delay(volatile uint32_t nCount)
{
    for (; nCount != 0; nCount--);
}

